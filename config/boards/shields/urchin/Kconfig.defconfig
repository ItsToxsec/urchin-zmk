## config/boards/shields/urchin/Kconfig.defconfig
```kconfig
# Copyright (c) 2020 The ZMK Contributors
# SPDX-License-Identifier: MIT

if SHIELD_URCHIN_DONGLE

config ZMK_KEYBOARD_NAME
	default "Urchin Dongle"
	
config ZMK_SPLIT_BLE_ROLE_CENTRAL
	default y
	
config ZMK_USB
	default y

endif

if SHIELD_URCHIN_LEFT || SHIELD_URCHIN_RIGHT || SHIELD_URCHIN_DONGLE 

config ZMK_SPLIT
	default y

config ZMK_BLE
	default y
	
endif
```

## config/west.yml
```yaml
manifest:
    remotes:
        # zmk official
        - name: zmkfirmware
          url-base: https://github.com/zmkfirmware
          # bravekarma
        - name: caksoylar
          url-base: https://github.com/caksoylar
          # kyek / duckyb
        - name: duckyb
          url-base: https://github.com/duckyb
        - name: ItsToxsec
          url-base: https://github.com/ItsToxsec
    projects:
        - name: zmk
          remote: zmkfirmware
          revision: main
          import: app/west.yml
        - name: urchin-zmk-module
          remote: duckyb
          revision: main
        - name: nice-view-sly
          remote: ItsToxsec
          revision: main
    self:
        path: config
```
