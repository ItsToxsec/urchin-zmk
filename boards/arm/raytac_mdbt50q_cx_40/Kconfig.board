## config/boards/arm/raytac_mdbt50q_cx_40_dongle/Kconfig.board
```kconfig
# SPDX-License-Identifier: MIT

config BOARD_RAYTAC_MDBT50Q_CX_40_DONGLE
    bool "Raytac MDBT50Q-CX-40 Dongle"
    depends on SOC_NRF52840_QIAA
```

## config/west.yml
```yaml
manifest:
    remotes:
        # zmk official
        - name: zmkfirmware
          url-base: https://github.com/zmkfirmware
          # bravekarma
        - name: caksoylar
          url-base: https://github.com/caksoylar
          # kyek / duckyb
        - name: duckyb
          url-base: https://github.com/duckyb
        - name: ItsToxsec
          url-base: https://github.com/ItsToxsec
        - name: perrwa
          url-base: https://github.com/perrwa
    projects:
        - name: zmk
          remote: zmkfirmware
          revision: v0.3.0
          import: app/west.yml
        - name: zmk-component-raytac-dongle
          remote: perrwa
          revision: v0.3
        - name: urchin-zmk-module
          remote: duckyb
          revision: main
        - name: nice-view-sly
          remote: ItsToxsec
          revision: main
    self:
        path: config
```
